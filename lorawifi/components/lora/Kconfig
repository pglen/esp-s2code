## lorawifi/components/lora/Kconfig
```kconfig
menu "LoRa Configuration"

config CS_GPIO
    int "CS GPIO"
    range 0 46
    default 42
    help
	Pin Number where the NCS pin of the LoRa module is connected to.

config RST_GPIO
    int "RST GPIO"
    range 0 46
    default 41
    help
	Pin Number where the NRST pin of the LoRa module is connected to.

config MISO_GPIO
    int "MISO GPIO"
    range 0 46
    default 36
    help
	Pin Number to be used as the MISO SPI signal.

config MOSI_GPIO
    int "MOSI GPIO"
    range 0 46
    default 37
    help
	Pin Number to be used as the MOSI SPI signal.

config SCK_GPIO
    int "SCK GPIO"
    range 0 46
    default 40
    help
	Pin Number to be used as the SCK SPI signal.

endmenu
```

## lorawifi/main/Kconfig.projbuild
```kconfig
menu "Lora WiFi Configuration"

    config ESP_MAX_STA_CONN
        int "Maximum STA connections"
        default 4
        help
            Max number of the STA can connect to AP.

    config ESP_WIFI_CHANNEL
        int "Default Wifi Channel"
        default 0
        help
            Chanel the Wifi subsystem is listening on

    config ESP_GTK_REKEYING_ENABLE
        bool "Enable GTK Rekeying"
        default y
        help
            Flag to enable GTK rekeying.

    config ESP_GTK_REKEY_INTERVAL
        int "GTK rekey interval"
        depends on ESP_GTK_REKEYING_ENABLE
        range 60 65535
        default 600
        help
            GTK rekeying interval in seconds.
endmenu
```
